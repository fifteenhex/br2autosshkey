## package/autosshkey/Config.in
```kconfig
config BR2_PACKAGE_AUTOSSHKEY
	bool "autosshkey"

config BR2_PACKAGE_AUTOSSHKEY_USERS
	depends on BR2_PACKAGE_AUTOSSHKEY
	string "space separated list of users to generate keys for"
```
